#include <WiFi.h>
#include <ESPAsyncWebServer.h>
#include <ESPmDNS.h>

#include "Adafruit_VL53L0X.h"
#include <Wire.h>





bool serial_Trigger( ) {

    static unsigned long triggerCurrentTime = micros( ) ;

    if( ( clock_getTimeMicros( ) - triggerCurrentTime ) < 1000000L ) {

        return( false ) ;

    } else { 

        triggerCurrentTime = clock_getTimeMicros( ) ;

        return( true ) ;

    }

}



///////////////////////////////////////////////////////////////////


#define serial_modulename F( "serial_" )



void serial_Log( const __FlashStringHelper * k , unsigned long i ) {

    log_initClientModule( serial_modulename , k ) ;
    log_print( i ) ;

}



void serial_Setups( ) {

    serial_setup( ) ;

}




void serial_Loops( ) {

    if( ! serial_Trigger( ) ) return ;

    serial_loop( ) ;

}


///////////////////////////////////////////////////////////////////


///////////////////////////////////////////////////////////////////

const byte serial_numChars = 32 ;

char serial_receivedChars[ serial_numChars ] ;
char serial_tempChars[ serial_numChars ] ; 

boolean serial_newData = false ;

///////////////////////////////////////////////////////////////////

void serial_setup( ) {

    Serial.begin( 115200 ) ;

}

///////////////////////////////////////////////////////////////////

void serial_loop( ) {

    serial_recvWithStartEndMarkers( ) ;

    if( serial_newData == true ) {

        strcpy( serial_tempChars , serial_receivedChars ) ;

        wizard_incomingParse( serial_tempChars ) ;

        serial_newData = false ;

    }

}

///////////////////////////////////////////////////////////////////

void serial_recvWithStartEndMarkers( ) {

    static boolean recvInProgress = false ;
    static byte ndx = 0 ;

    char startMarker = '<' ;
    char endMarker = '>' ;

    char rc ;

    while( Serial.available( ) > 0 && serial_newData == false ) {

        rc = Serial.read( ) ;

        if( rc == '\n' ) {

            serial_receivedChars[ 0 ] = '\0' ;

            recvInProgress = false ;
            
            ndx = 0 ;

            serial_newData = false ;

            continue ;

        }

        if( recvInProgress == true ) {

            if( rc != endMarker ) {

                serial_receivedChars[ ndx ] = rc ; 

                ndx++ ;

                if( ndx >= serial_numChars ) {

                    ndx = serial_numChars - 1 ;

                }

            } else {

                serial_receivedChars[ ndx ] = '\0' ;

                recvInProgress = false ;

                ndx = 0 ;

                serial_newData = true ;

            }

        } else if( rc == startMarker ) {

            recvInProgress = true ;

        }

    }

}







bool log_Trigger( ) {

    static unsigned long triggerCurrentTime = micros( ) ;

    if( ( clock_getTimeMicros( ) - triggerCurrentTime ) < 10000000L ) {

        return( false ) ;

    } else { 

        triggerCurrentTime = clock_getTimeMicros( ) ;

        return( true ) ;

    }

}





void log_Setups( ) {

    log_setup( ) ;

}




void log_Loops( ) {

    if( ! log_Trigger( ) ) return ;

    log_loop( ) ;

}




#define log_clientmodulebufSize 20

char log_clientmodulebuf[ log_clientmodulebufSize ] ;


void log_setup( ) {

}

void log_loop( ) {

    log_initClientModule( F( "log_" ) , F( "hb" ) ) ;

    log_print( F( "@" ) ) ;


}

void log_initClientModule( const __FlashStringHelper * c , const __FlashStringHelper * m ) {

    snprintf_P( log_clientmodulebuf , log_clientmodulebufSize , PSTR( "%S|%S" ) , c , m ) ;

}

template <class T> void log_print( T t ) {

  Serial.print( t ) ; 

} ;


/*
void log_print( const __FlashStringHelper * i ) {

    log_timeclientstamp( ) ;
    wizard_serialPrint( i , true ) ;

}


void log_print( char * i ) {

    log_timeclientstamp( ) ;
    wizard_serialPrint( i , true ) ;

}


void log_print( byte i ) {

    log_timeclientstamp( ) ;
    wizard_serialPrint( i , true ) ;

}


void log_print( int i ) {

    log_timeclientstamp( ) ;
    wizard_serialPrint( i , true ) ;

}


void log_print( unsigned int i ) {

    log_timeclientstamp( ) ;
    wizard_serialPrint( i , true ) ;

}

void log_print( long i ) {

    log_timeclientstamp( ) ;
    wizard_serialPrint( i , true ) ;

}

void log_print( unsigned long i ) {

    log_timeclientstamp( ) ;
    wizard_serialPrint( i , true ) ;

}


*/


/*
void log_timeclientstamp( ) {

    wizard_serialPrint( clock_getTimeMillis( ) , false ) ;
    //wizard_serialPrint( rtc_millis() , false ) ;

    wizard_serialPrint( F( "|" )  , false ) ;
    wizard_serialPrint( log_clientmodulebuf , false ) ;
    wizard_serialPrint( F( "|" ) , false ) ;

}
*/







///////////////////////////////////////



void clock_Setups( ) {

    clock_setup( ) ;

}



// DO NOT USE LOOPS MACRO!
// This defines its own Loop


///////////////////////////////////////

unsigned long clock_timeMillis = millis( ) ;
unsigned long clock_timeMicros = micros( ) ;

///////////////////////////////////////

void clock_setup( ) {


}

void clock_Loops( ) {


    clock_timeMillis = millis( ) ;
    clock_timeMicros = micros( ) ;

    delayMicroseconds( 100 ) ;

}

///////////////////////////////////////

unsigned long clock_getTimeMillis( ) {

    return( clock_timeMillis ) ;

}

unsigned long clock_getTimeMicros( ) {

    return( clock_timeMicros ) ;

}






//////////////////////////////////////


bool led_Trigger( ) {

    static unsigned long triggerCurrentTime = micros( ) ;

    if( ( clock_getTimeMicros( ) - triggerCurrentTime ) < 1000L ) {

        return( false ) ;

    } else { 

        triggerCurrentTime = clock_getTimeMicros( ) ;

        return( true ) ;

    }

}



#define led_modulename F( "led_" )



void led_Log( const __FlashStringHelper * k , unsigned long i ) {

    log_initClientModule( led_modulename , k ) ;
    log_print( i ) ;

}



void led_Setups( ) {

    led_setup( ) ;

}




void led_Loops( ) {

    if( ! led_Trigger( ) ) return ;

    led_loop( ) ;

}


///////////////////////////////////////


int led_flash_sequence = 0 ;
int led_flash_sequence_pointer = 0 ;

int led_flash_sequence_1[ 10 ] ;
int led_flash_sequence_2[ 10 ] ;
int led_flash_sequence_3[ 10 ] ;

unsigned long led_state_time = 0 ;
bool led_state = false ;

//////////////////////////////////////

const byte led_pin = 16 ;

//////////////////////////////////////

void led_setup( ) {

  pinMode( led_pin , OUTPUT ) ;

  led_flash_sequence_1[ 0 ] = 1000 ;
  led_flash_sequence_1[ 1 ] = 1 ;
  led_flash_sequence_1[ 2 ] = -1 ;

  led_flash_sequence_2[ 0 ] = 1 ;
  led_flash_sequence_2[ 1 ] = 3000 ;
  led_flash_sequence_2[ 2 ] = -1 ;

  led_flash_sequence_3[ 0 ] = 1 ;
  led_flash_sequence_3[ 1 ] = 100 ;
  led_flash_sequence_3[ 2 ] = 1 ;
  led_flash_sequence_3[ 3 ] = 2999 ;
  led_flash_sequence_3[ 6 ] = -1 ;

  led_flash_sequence = 1 ;

  digitalWrite( led_pin , HIGH ) ;

}

///////////////////////////////////////

void led_loop( ) {

  if( led_flash_sequence == 0 ) return ;

  if( led_flash_sequence == 1 ) {

     if( clock_getTimeMillis( ) > led_state_time ) {

      if( led_flash_sequence_1[ led_flash_sequence_pointer ] == -1 ) {

        led_flash_sequence_pointer = 0 ;
        led_state = false ;

      }


     if(led_state){
      digitalWrite( led_pin , HIGH ) ;
     }else{
      digitalWrite( led_pin , LOW ) ;

     }

      led_state_time = clock_getTimeMillis( )  + led_flash_sequence_1[ led_flash_sequence_pointer ] ;

      led_state = !led_state ;
      led_flash_sequence_pointer++ ;

     }

    return ;

  }

////
    if( led_flash_sequence == 2 ) {

     if( clock_getTimeMillis( ) > led_state_time ) {

      if( led_flash_sequence_2[ led_flash_sequence_pointer ] == -1 ) {

        led_flash_sequence_pointer = 0 ;
        led_state = false ;

      }


     if(led_state){
      digitalWrite( led_pin , HIGH ) ;
     }else{
      digitalWrite( led_pin , LOW ) ;

     }

      led_state_time = clock_getTimeMillis( )  + led_flash_sequence_2[ led_flash_sequence_pointer ] ;

      led_state = !led_state ;
      led_flash_sequence_pointer++ ;

     }

    return ;

  }


////
    if( led_flash_sequence == 3 ) {

     if( clock_getTimeMillis( ) > led_state_time ) {

      if( led_flash_sequence_3[ led_flash_sequence_pointer ] == -1 ) {

        led_flash_sequence_pointer = 0 ;
        led_state = false ;

      }


     if(led_state){
      digitalWrite( led_pin , HIGH ) ;
     }else{
      digitalWrite( led_pin , LOW ) ;

     }

      led_state_time = clock_getTimeMillis( )  + led_flash_sequence_3[ led_flash_sequence_pointer ] ;

      led_state = !led_state ;
      led_flash_sequence_pointer++ ;

     }

    return ;

  }

}

void led_set_sequence( int s ) {

  if(led_flash_sequence!=s){
    led_flash_sequence = s ;
    led_flash_sequence_pointer = 0 ;
    led_state = false ;
  }

}

//////////////////////////////////////


bool audio_Trigger( ) {

    static unsigned long triggerCurrentTime = micros( ) ;

    if( ( clock_getTimeMicros( ) - triggerCurrentTime ) < 10000L ) {

        return( false ) ;

    } else { 

        triggerCurrentTime = clock_getTimeMicros( ) ;

        return( true ) ;

    }

}



#define audio_modulename F( "audio_" )



void audio_Log( const __FlashStringHelper * k , unsigned long i ) {

    log_initClientModule( audio_modulename , k ) ;
    log_print( i ) ;

}



void audio_Setups( ) {

    audio_setup( ) ;

}




void audio_Loops( ) {

    if( ! audio_Trigger( ) ) return ;

    audio_loop( ) ;

}


///////////////////////////////////////


//////////////////////////////////////

const byte audio_pin = 17 ;
const byte audio_channel = 2 ;

//////////////////////////////////////

void audio_setup( ) {

  //pinMode( audio_pin , OUTPUT ) ;

  //ledcSetup( audio_channel , 40 , 8 ) ;
  //ledcAttachPin( audio_pin , audio_channel ) ;
  //ledcWrite( audio_channel  , 50 ) ;

}

///////////////////////////////////////

void audio_loop( ) {


}





bool websocketserver_Trigger( ) {

    static unsigned long triggerCurrentTime = micros( ) ;

    if( ( clock_getTimeMicros( ) - triggerCurrentTime ) < 10000L ) {

        return( false ) ;

    } else { 

        triggerCurrentTime = clock_getTimeMicros( ) ;

        return( true ) ;

    }

}



#define websocketserver_modulename F( "websocketserver_" )



void websocketserver_Log( const __FlashStringHelper * k , unsigned long i ) {

    log_initClientModule( websocketserver_modulename , k ) ;
    log_print( i ) ;

}



void websocketserver_Setups( ) {

    websocketserver_setup( ) ;

}




void websocketserver_Loops( ) {

    if( ! websocketserver_Trigger( ) ) return ;

    websocketserver_loop( ) ;

}



///////////////////////////////////////

const char* websocketserver_ssid = "SID";
const char* websocketserver_password =  "PASSWORD";
 
AsyncWebServer websocketserver_server( 80 ) ;
AsyncWebSocket websocketserver_ws( "/ws" ) ;

bool websocketserver_connected = false ; 

bool websocketserver_monitor = false ; 

AsyncWebSocketClient * websocketserver_globalClient = NULL ;

char websocketserver_incoming[ 1024 ] ;



const char websocketserver_HTML1[ ] PROGMEM = { 60,33,100,111,99,116,121,112,101,32,104,116,109,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62 , 0 } ;
const char websocketserver_HTML2[ ] PROGMEM = { 60,33,68,79,67,84,89,80,69,32,72,84,77,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62 , 0 } ;


void websocketserver_setup_( ) {


  websocketserver_connected = false ;

  WiFi.begin( websocketserver_ssid , websocketserver_password ) ;
  WiFi.setSleep( false ) ;


/* 
  while( WiFi.status( ) != WL_CONNECTED ) {

    Serial.print( "." ) ;

    delay( 1000 ) ;
  
  }
*/
  
  if( MDNS.begin( "mightymouse" ) ) { }

  websocketserver_ws.onEvent( onWsEvent ) ;
  websocketserver_server.addHandler( &websocketserver_ws ) ;
   
  websocketserver_server.on( "/" , HTTP_GET , [ ]( AsyncWebServerRequest *request ) {

    request->send( 200 , "text/html" , websocketserver_HTML1 ) ;
  
  } ) ;

  websocketserver_server.on( "/mon" , HTTP_GET , [ ]( AsyncWebServerRequest *request ) {

    request->send( 200 , "text/html" , websocketserver_HTML2 ) ;
  
  } ) ;

  websocketserver_server.on( "/reset" , HTTP_GET , [ ]( AsyncWebServerRequest *request ) {

    request->send( 200 , "text/html" , "ok" ) ;
    delay( 2000 ) ;
    ESP.restart( ) ;

  } ) ;

  websocketserver_server.begin( ) ;


}

void websocketserver_loop_( ) {

 //ws.printfAll( "%d" , millis( ) ) ;
  if( websocketserver_monitor ) {

    //if( websocketserver_globalClient != NULL && websocketserver_globalClient->status( ) == WS_CONNECTED ) {

      websocketserver_ws.printfAll( "%d,_,%d,%d,%.2f,%d" , clock_getTimeMillis( ) , encoder1_get( ) , encoder2_get( ) , imu_getz( ) , distance_get_range( ) ) ;
      //websocketserver_globalclient->printf( "%d,_,%d,%d,%.2f,%d" , clock_getTimeMillis( ) , encoder1_get( ) , encoder2_get( ) , imu_getz( ) , distance_get_range( ) ) ;
      //websocketserver_ws.printfAll( "%d" , encoder1_get( ) ) ;
    
    //}
  
  }

}

///////////////////////////////////////

void websocketserver_setup( ) {

  websocketserver_setup_( ) ;

}

void websocketserver_loop( ) {

  websocketserver_loop_( ) ;
 
}

///////////////////////////////////////

void websocketserver_broadcast_trigger( int t ) {

  //Serial.println( "TRIGGER" ) ;

  motor1_stop( ) ;
  motor2_stop( ) ;

  encoder1_trigger_disable( ) ;
  encoder2_trigger_disable( ) ;
  
  imu_trigger_disable( ) ;
  
  distance_trigger_disable( ) ;

  motor1_trigger_disable( ) ;
  motor2_trigger_disable( ) ;

  websocketserver_ws.printfAll( "%d,T,%d" , clock_getTimeMillis( ) , t ) ;
  
    //websocketserver_globalClient->printf( "%d,_trigger,o,k" , clock_getTimeMillis( ) ) ;
  

}

///////////////////////////////////////

void onWsEvent( AsyncWebSocket * server , AsyncWebSocketClient * client , AwsEventType type , void * arg , uint8_t *data , size_t len ) {
 
  if( type == WS_EVT_CONNECT ) {
 
    //Serial.println( "WS_EVT_CONNECT" ) ;
    client->text( "\n" ) ;
   //websocketserver_globalClient = client ;
    websocketserver_connected = true ;
   return ;

  } else if( type == WS_EVT_DISCONNECT ) {

    //Serial.println( "Client disconnected" ) ;
    //websocketserver_globalClient = NULL ;
    websocketserver_connected = false ;
    return ;
 
  } else if( type == WS_EVT_DATA ) {


    strncpy ( websocketserver_incoming , ( char * ) data , len ) ;
    websocketserver_incoming[ len ] = '\0' ;

    if( ! wizard_incomingParse( websocketserver_incoming ) ) {

      Serial.print( websocketserver_incoming ) ;
      Serial.println( "???" ) ; 

    }

    return ;

  }

}

bool websocketserver_get_connected( ) {

  return( websocketserver_connected ) ;

}



//////////////////////////////////////


bool encoder1_Trigger( ) {

    static unsigned long triggerCurrentTime = micros( ) ;

    if( ( clock_getTimeMicros( ) - triggerCurrentTime ) < 50000L ) {

        return( false ) ;

    } else { 

        triggerCurrentTime = clock_getTimeMicros( ) ;

        return( true ) ;

    }

}



#define encoder1_modulename F( "encoder1_" )



void encoder1_Log( const __FlashStringHelper * k , unsigned long i ) {

    log_initClientModule( encoder1_modulename , k ) ;
    log_print( i ) ;

}



void encoder1_Setups( ) {

    encoder1_setup( ) ;

}




void encoder1_Loops( ) {

    if( ! encoder1_Trigger( ) ) return ;

    encoder1_loop( ) ;

}


///////////////////////////////////////


//////////////////////////////////////

const byte encoder1_id = 1 ;

const byte encoder1_a_pin = 33 ;
const byte encoder1_b_pin = 32 ;

const byte encoder1_detect = RISING ;
//////////////////////////////////////


portMUX_TYPE encoder1_mux = portMUX_INITIALIZER_UNLOCKED ;

volatile long encoder1_count = 0 ;

int encoder1_trigger = -1 ;
int encoder1_trigger_direction = 0 ;

void encoder1_setup_( ) {

  pinMode( encoder1_a_pin , INPUT_PULLUP ) ;
  pinMode( encoder1_b_pin , INPUT_PULLUP ) ;

  attachInterrupt( digitalPinToInterrupt( encoder1_a_pin ) , encoder1_event , encoder1_detect ) ;

}

void encoder1_loop_( ) {

  if( encoder1_trigger_direction == 0 ) return ;

  if( encoder1_trigger_direction == 1 ) {

    if( encoder1_count >= encoder1_trigger ) {

      encoder1_trigger_action( ) ;

    }
    
    return;
  
  }  

  if( encoder1_trigger_direction == -1 ) {
    
    if( encoder1_count <= encoder1_trigger ) {

      encoder1_trigger_action( ) ;

    }

    return ;

  }  

}

void encoder1_trigger_disable( ) {

  encoder1_trigger_direction = 0 ;

}

void encoder1_trigger_action( ) {


/*
  if( encoder1_id == 1 ) {

      motor1_stop( ) ;
  
  }

  if( encoder1_id == 2 ) {

      motor2_stop( ) ;
  
  }
*/

  websocketserver_broadcast_trigger( ( 2 - encoder1_id ) + 3  ) ;

  encoder1_trigger_direction = 0 ;

}

void encoder1_set( long v ) {

  portENTER_CRITICAL_ISR( &encoder1_mux ) ;

  encoder1_count = v ;

  portEXIT_CRITICAL_ISR( &encoder1_mux ) ;

}

long encoder1_get( ) {

  return( encoder1_count ) ;


}

void encoder1_countEventUpdate( int v ) {

  portENTER_CRITICAL_ISR( &encoder1_mux ) ;

  encoder1_count -= v ;

  portEXIT_CRITICAL_ISR( &encoder1_mux ) ;

}

void encoder1_event( ) {

  if( digitalRead( encoder1_a_pin ) == HIGH ) {

    if( digitalRead( encoder1_b_pin ) == LOW ) {
    
      encoder1_countEventUpdate( 1 ) ;
    
    } else {
    
      encoder1_countEventUpdate( -1 ) ;
    
    }

  } else {
    
    if( digitalRead( encoder1_b_pin ) == LOW ) {
  
      encoder1_countEventUpdate( -1 ) ;
  
    } else {

      encoder1_countEventUpdate( 1 ) ;
  
    }

  }

}

void encoder1_set_trigger( int t ) {

  encoder1_trigger = encoder1_count + t ;
  
  if( t > 0 ) {

    encoder1_trigger_direction = 1 ;

  } else {
  
    encoder1_trigger_direction = -1 ;

  }


}



//////////////////////////////////////

void encoder1_setup( ) {

    encoder1_setup_( ) ;

}

///////////////////////////////////////

void encoder1_loop( ) {

    encoder1_loop_( ) ;

}



//////////////////////////////////////


bool encoder2_Trigger( ) {

    static unsigned long triggerCurrentTime = micros( ) ;

    if( ( clock_getTimeMicros( ) - triggerCurrentTime ) < 50000L ) {

        return( false ) ;

    } else { 

        triggerCurrentTime = clock_getTimeMicros( ) ;

        return( true ) ;

    }

}



#define encoder2_modulename F( "encoder2_" )



void encoder2_Log( const __FlashStringHelper * k , unsigned long i ) {

    log_initClientModule( encoder2_modulename , k ) ;
    log_print( i ) ;

}



void encoder2_Setups( ) {

    encoder2_setup( ) ;

}




void encoder2_Loops( ) {

    if( ! encoder2_Trigger( ) ) return ;

    encoder2_loop( ) ;

}


///////////////////////////////////////


//////////////////////////////////////

const byte encoder2_id = 2 ;

const byte encoder2_a_pin = 35 ;
const byte encoder2_b_pin = 34 ;

const byte encoder2_detect = CHANGE ;

//////////////////////////////////////


portMUX_TYPE encoder2_mux = portMUX_INITIALIZER_UNLOCKED ;

volatile long encoder2_count = 0 ;

int encoder2_trigger = -1 ;
int encoder2_trigger_direction = 0 ;

void encoder2_setup_( ) {

  pinMode( encoder2_a_pin , INPUT_PULLUP ) ;
  pinMode( encoder2_b_pin , INPUT_PULLUP ) ;

  attachInterrupt( digitalPinToInterrupt( encoder2_a_pin ) , encoder2_event , encoder2_detect ) ;

}

void encoder2_loop_( ) {

  if( encoder2_trigger_direction == 0 ) return ;

  if( encoder2_trigger_direction == 1 ) {

    if( encoder2_count >= encoder2_trigger ) {

      encoder2_trigger_action( ) ;

    }
    
    return;
  
  }  

  if( encoder2_trigger_direction == -1 ) {
    
    if( encoder2_count <= encoder2_trigger ) {

      encoder2_trigger_action( ) ;

    }

    return ;

  }  

}

void encoder2_trigger_disable( ) {

  encoder2_trigger_direction = 0 ;

}

void encoder2_trigger_action( ) {


/*
  if( encoder2_id == 1 ) {

      motor1_stop( ) ;
  
  }

  if( encoder2_id == 2 ) {

      motor2_stop( ) ;
  
  }
*/

  websocketserver_broadcast_trigger( ( 2 - encoder2_id ) + 3  ) ;

  encoder2_trigger_direction = 0 ;

}

void encoder2_set( long v ) {

  portENTER_CRITICAL_ISR( &encoder2_mux ) ;

  encoder2_count = v ;

  portEXIT_CRITICAL_ISR( &encoder2_mux ) ;

}

long encoder2_get( ) {

  return( encoder2_count ) ;


}

void encoder2_countEventUpdate( int v ) {

  portENTER_CRITICAL_ISR( &encoder2_mux ) ;

  encoder2_count -= v ;

  portEXIT_CRITICAL_ISR( &encoder2_mux ) ;

}

void encoder2_event( ) {

  if( digitalRead( encoder2_a_pin ) == HIGH ) {

    if( digitalRead( encoder2_b_pin ) == LOW ) {
    
      encoder2_countEventUpdate( 1 ) ;
    
    } else {
    
      encoder2_countEventUpdate( -1 ) ;
    
    }

  } else {
    
    if( digitalRead( encoder2_b_pin ) == LOW ) {
  
      encoder2_countEventUpdate( -1 ) ;
  
    } else {

      encoder2_countEventUpdate( 1 ) ;
  
    }

  }

}

void encoder2_set_trigger( int t ) {

  encoder2_trigger = encoder2_count + t ;
  
  if( t > 0 ) {

    encoder2_trigger_direction = 1 ;

  } else {
  
    encoder2_trigger_direction = -1 ;

  }


}



//////////////////////////////////////

void encoder2_setup( ) {

    encoder2_setup_( ) ;

}

///////////////////////////////////////

void encoder2_loop( ) {

    encoder2_loop_( ) ;

}



//////////////////////////////////////


bool motor1_Trigger( ) {

    static unsigned long triggerCurrentTime = micros( ) ;

    if( ( clock_getTimeMicros( ) - triggerCurrentTime ) < 1000L ) {

        return( false ) ;

    } else { 

        triggerCurrentTime = clock_getTimeMicros( ) ;

        return( true ) ;

    }

}



#define motor1_modulename F( "motor1_" )



void motor1_Log( const __FlashStringHelper * k , unsigned long i ) {

    log_initClientModule( motor1_modulename , k ) ;
    log_print( i ) ;

}



void motor1_Setups( ) {

    motor1_setup( ) ;

}




void motor1_Loops( ) {

    if( ! motor1_Trigger( ) ) return ;

    motor1_loop( ) ;

}


///////////////////////////////////////


//////////////////////////////////////

const byte motor1_id = 1 ;

const byte motor1_pin = 25 ;

const byte motor1_in2_pin = 27 ;
const byte motor1_in1_pin = 26 ;

const byte motor1_channel = 0 ;

//////////////////////////////////////


int motor1_power = 20 ;

unsigned long motor1_timer_val = 0 ;
unsigned long motor1_timer_marker = 0 ;
bool motor1_timer_enabled = false ;

void motor1_setup_( ) {

  pinMode( motor1_in1_pin , OUTPUT ) ;
  pinMode( motor1_in2_pin , OUTPUT ) ;

  ledcSetup( motor1_channel , 5000 , 8 ) ;
  ledcAttachPin( motor1_pin , motor1_channel ) ;

  motor1_stop( ) ;
  motor1_set_power( motor1_power ) ;

}

void motor1_loop_( ) {

  if(!motor1_timer_enabled) return;

  if( ( clock_getTimeMillis( ) - motor1_timer_marker ) >= motor1_timer_val ) {
    motor1_timer_enabled=false;

    websocketserver_broadcast_trigger( (2-motor1_id) + 8 ) ;

  }

}

void motor1_start( ) {
   
  ledcWrite( motor1_channel  , map( abs( motor1_power ) , 0 , 100 , 0 , 192 ) ) ;

}



void motor1_stop( ) {

  ledcWrite( motor1_channel  , 0 ) ;

}

void motor1_set_power( int p ) {

  motor1_power = p ;

    if( motor1_power > 0 ) {

        digitalWrite( motor1_in1_pin , false ) ;  
        digitalWrite( motor1_in2_pin , true ) ;  

    } else {

        digitalWrite( motor1_in1_pin , true ) ;  
        digitalWrite( motor1_in2_pin , false ) ;  

    }

  //Serial.println(motor1_power_user);

}

int motor1_get_power( ) {

  return( motor1_power ) ;
  //Serial.println(motor1_power_user);

}

void motor1_trigger_disable( ) {
  motor1_timer_enabled = false ;
}

void motor1_timer_set( unsigned long t ) {
  motor1_timer_val = t ;
  motor1_timer_marker = clock_getTimeMillis( ) ;
  motor1_timer_enabled = true ;  
}



//////////////////////////////////////

void motor1_setup( ) {

    motor1_setup_( ) ;

}

///////////////////////////////////////

void motor1_loop( ) {

    motor1_loop_( ) ;

}



//////////////////////////////////////


bool motor2_Trigger( ) {

    static unsigned long triggerCurrentTime = micros( ) ;

    if( ( clock_getTimeMicros( ) - triggerCurrentTime ) < 1000L ) {

        return( false ) ;

    } else { 

        triggerCurrentTime = clock_getTimeMicros( ) ;

        return( true ) ;

    }

}



#define motor2_modulename F( "motor2_" )



void motor2_Log( const __FlashStringHelper * k , unsigned long i ) {

    log_initClientModule( motor2_modulename , k ) ;
    log_print( i ) ;

}



void motor2_Setups( ) {

    motor2_setup( ) ;

}




void motor2_Loops( ) {

    if( ! motor2_Trigger( ) ) return ;

    motor2_loop( ) ;

}


///////////////////////////////////////


//////////////////////////////////////

const byte motor2_id = 2 ;

const byte motor2_pin = 12 ;

const byte motor2_in1_pin = 13 ;
const byte motor2_in2_pin = 14 ;

const byte motor2_channel = 1 ;

//////////////////////////////////////


int motor2_power = 20 ;

unsigned long motor2_timer_val = 0 ;
unsigned long motor2_timer_marker = 0 ;
bool motor2_timer_enabled = false ;

void motor2_setup_( ) {

  pinMode( motor2_in1_pin , OUTPUT ) ;
  pinMode( motor2_in2_pin , OUTPUT ) ;

  ledcSetup( motor2_channel , 5000 , 8 ) ;
  ledcAttachPin( motor2_pin , motor2_channel ) ;

  motor2_stop( ) ;
  motor2_set_power( motor2_power ) ;

}

void motor2_loop_( ) {

  if(!motor2_timer_enabled) return;

  if( ( clock_getTimeMillis( ) - motor2_timer_marker ) >= motor2_timer_val ) {
    motor2_timer_enabled=false;

    websocketserver_broadcast_trigger( (2-motor2_id) + 8 ) ;

  }

}

void motor2_start( ) {
   
  ledcWrite( motor2_channel  , map( abs( motor2_power ) , 0 , 100 , 0 , 192 ) ) ;

}



void motor2_stop( ) {

  ledcWrite( motor2_channel  , 0 ) ;

}

void motor2_set_power( int p ) {

  motor2_power = p ;

    if( motor2_power > 0 ) {

        digitalWrite( motor2_in1_pin , false ) ;  
        digitalWrite( motor2_in2_pin , true ) ;  

    } else {

        digitalWrite( motor2_in1_pin , true ) ;  
        digitalWrite( motor2_in2_pin , false ) ;  

    }

  //Serial.println(motor2_power_user);

}

int motor2_get_power( ) {

  return( motor2_power ) ;
  //Serial.println(motor2_power_user);

}

void motor2_trigger_disable( ) {
  motor2_timer_enabled = false ;
}

void motor2_timer_set( unsigned long t ) {
  motor2_timer_val = t ;
  motor2_timer_marker = clock_getTimeMillis( ) ;
  motor2_timer_enabled = true ;  
}



//////////////////////////////////////

void motor2_setup( ) {

    motor2_setup_( ) ;

}

///////////////////////////////////////

void motor2_loop( ) {

    motor2_loop_( ) ;

}



#include <MPU6050_tockn.h>

//////////////////////////////////////


bool imu_Trigger( ) {

    static unsigned long triggerCurrentTime = micros( ) ;

    if( ( clock_getTimeMicros( ) - triggerCurrentTime ) < 50000L ) {

        return( false ) ;

    } else { 

        triggerCurrentTime = clock_getTimeMicros( ) ;

        return( true ) ;

    }

}



#define imu_modulename F( "imu_" )



void imu_Log( const __FlashStringHelper * k , unsigned long i ) {

    log_initClientModule( imu_modulename , k ) ;
    log_print( i ) ;

}



void imu_Setups( ) {

    imu_setup( ) ;

}




void imu_Loops( ) {

    if( ! imu_Trigger( ) ) return ;

    imu_loop( ) ;

}


///////////////////////////////////////


//////////////////////////////////////

MPU6050 imu_mpu6050( Wire ) ;

float imu_z = 0 ;

float imu_z_init = 0 ;

bool imu_z_init_flag = true ;

int imu_trigger = -1 ;
int imu_trigger_direction = 0 ;

void imu_setup( ) {

  Wire.begin( ) ;

  imu_mpu6050.begin( ) ;
  imu_mpu6050.calcGyroOffsets( true ) ;

}

///////////////////////////////////////

void imu_loop( ) {

  imu_mpu6050.update( ) ;
  //Serial.print("angleX : ");
  //Serial.print(mpu6050.getAngleX());
  //Serial.print("\tangleY : ");
  //Serial.print(mpu6050.getAngleY());
  if( imu_z_init_flag ) {

     imu_z_init =  imu_mpu6050.getAngleZ( ) / -1.0 ;
     imu_z = 0 ; 
     imu_z_init_flag = false ;

  } else {

    imu_z = ( imu_mpu6050.getAngleZ( ) / -1.0 ) - imu_z_init ;
  
  }

  //Serial.println( imu_z ) ;

  if( imu_trigger_direction == 0 ) return ;

  if( imu_trigger_direction == 1 ) {

    if( imu_z >= imu_trigger ) {

      imu_trigger_direction = 0 ;

      websocketserver_broadcast_trigger( 5 ) ;
      //Serial.println("imu_ TRIGGER HIGH!");
      imu_trigger_direction = 0 ;

    }

    
    return;
  
  }  

  if( imu_trigger_direction == -1 ) {
    
    if( imu_z <= imu_trigger ) {

      websocketserver_broadcast_trigger( 5 ) ;

      //Serial.println( "imu_ TRIGGER LOW!" ) ;
      imu_trigger_direction = 0 ;

    }

    return ;

  }  
}

float imu_getz( ) {

  return( imu_z ) ;
  
}

void imu_zinit( ) {

    imu_z_init_flag=true;
  //imu_z_init = imu_z_init + imu_getz( ) ;
  imu_z = 0 ;

}

void imu_trigger_disable( ) {

  imu_trigger_direction = 0 ;

}

void imu_set_trigger( int t ) {

  imu_trigger = imu_z + t ;
  
  if( t > 0 ) {

    imu_trigger_direction = 1 ;

  } else {
  
    imu_trigger_direction = -1 ;

  }

}




bool distance_Trigger( ) {

    static unsigned long triggerCurrentTime = micros( ) ;

    if( ( clock_getTimeMicros( ) - triggerCurrentTime ) < 50000L ) {

        return( false ) ;

    } else { 

        triggerCurrentTime = clock_getTimeMicros( ) ;

        return( true ) ;

    }

}



#define distance_modulename F( "distance_" )



void distance_Log( const __FlashStringHelper * k , unsigned long i ) {

    log_initClientModule( distance_modulename , k ) ;
    log_print( i ) ;

}



void distance_Setups( ) {

    distance_setup( ) ;

}




void distance_Loops( ) {

    if( ! distance_Trigger( ) ) return ;

    distance_loop( ) ;

}


///////////////////////////////////////


//////////////////////////////////////


Adafruit_VL53L0X distance_lox = Adafruit_VL53L0X( ) ;

VL53L0X_RangingMeasurementData_t measure ;

int distance_range = 0 ;

bool distance_range_on = false ;
bool distance_range_ok = false ;
int distance_range_min = -1 ;
int distance_range_max = 99999 ;



void distance_setup( ) {

  if( !distance_lox.begin( ) ) {

    Serial.println( F( "Failed to boot VL53L0X" ) ) ;

    //while( 1 ) ;

  }


}

///////////////////////////////////////

void distance_loop( ) {

  distance_lox.rangingTest( &measure , false ) ; 

  if( measure.RangeStatus != 4 ) { 

    distance_range=measure.RangeMilliMeter ;
  
  } else {
  
    distance_range = 9999 ;
    distance_range_ok = false ;
    
    return ;
  
  }

  //Serial.println(distance_range);


  if( distance_range < 8000 && distance_range > 0 ) {

    if(!distance_range_ok){
      distance_range = 9992 ;
      distance_range_ok = true ;
      return;
    }

    distance_range_ok = true ;

  } else {

    distance_range_ok = false ;
    distance_range = 9991 ;
    return ;

  }

 // Serial.println( distance_trigger ) ;


  if( ! distance_range_on ) return ;

  if( ! distance_range_ok ) return ;

  if( (distance_range_min >= distance_range) || (distance_range_max<=distance_range) ) {

    if((distance_range_min >= distance_range)){
      websocketserver_broadcast_trigger( 6 ) ;
    }else{
      websocketserver_broadcast_trigger( 7 ) ;
    }
    //Serial.println("TRIGGER HIGH!");
    distance_range_min = -1 ;
    distance_range_max = 99999 ;
    distance_range_on=false;
    
    return;
  
  }  


}

void distance_trigger_disable( ) {

  distance_range_on = false ;

}

int distance_get_range( ) {

  return( distance_range ) ;

}

void distance_set_trigger_min( int t ) {

  distance_range_min = t ;
  distance_range_on = true ;

}

void distance_set_trigger_max( int t ) {

  distance_range_max = t ;
  distance_range_on = true ;

}




//? src/xpidencoder.php ?//




#define fsm_modulename F( "fsm_" )



void fsm_Log( const __FlashStringHelper * k , unsigned long i ) {

    log_initClientModule( fsm_modulename , k ) ;
    log_print( i ) ;

}


bool fsm_Trigger( ) {

    static unsigned long triggerCurrentTime = micros( ) ;

    if( ( clock_getTimeMicros( ) - triggerCurrentTime ) < 100L ) {

        return( false ) ;

    } else { 

        triggerCurrentTime = clock_getTimeMicros( ) ;

        return( true ) ;

    }

}





void fsm_Setups( ) {

    fsm_setup( ) ;

}




void fsm_Loops( ) {

    if( ! fsm_Trigger( ) ) return ;

    fsm_loop( ) ;

}




bool fsm_enabled = false ;

byte fsm_mode = 0 ;
byte fsm_state = 0 ;
byte fsm_step = 0 ;

bool fsm_changed = true ;


void fsm_setup( ) {

    
}


void fsm_loop( ) {

    if( !fsm_enabled ) return ;

    fsm_update( ) ;

    if( fsm_changed ) {

        static char buff[ 20 ] ;

        sprintf_P( buff , PSTR( "%i,%i,%i" ) , fsm_mode , fsm_state , fsm_step ) ;

        //fsm_Log( F( "MSS" ) , buff ) ;
        fsm_changed = false ;
        

    }

}



void fsm_update( ) {

    ////////////////////////////////

    
    //////////////////////////////////////
        if( fsm_mode == 1 ) {

            //fsm_Log( F( "fsm_ PRE MODE?" ) ) ;

            wizard_fsmModePre( ) ;

            
if( fsm_state == 1 ) {

    

if( fsm_step == 1 ) {

    fsm_stateSet( 2 ) ;

    return ;

}




    ////

    fsm_stepSet( 1 ) ;
    
    return ;

}


if( fsm_state == 2 ) {

    

if( fsm_step == 1 ) {

    fsm_stateSet( 3 ) ;

    return ;

}


    ////

    fsm_stepSet( 1 ) ;
    
    return ;

}


if( fsm_state == 3 ) {

    
if( fsm_step == 1 ) {

    fsm_stepNext( ) ;

    return ;

}


if( fsm_step == 2 ) {

	fsm_modeSet( 2 ) ;
    return ;

}




    ////

    fsm_stepSet( 1 ) ;
    
    return ;

}


            ////
            fsm_stateSet( 1 ) ;

            return ;

        }
    //////////////////////////////////////

    
    //////////////////////////////////////
        if( fsm_mode == 2 ) {

            //fsm_Log( F( "fsm_ PRE MODE?" ) ) ;

            wizard_fsmModePre( ) ;

            
if( fsm_state == 1 ) {

    

if( fsm_step == 1 ) {


  wizard_incoming_flag_listen_set( true ) ;

    fsm_stateSet( 2 ) ;

    return ;

}




    ////

    fsm_stepSet( 1 ) ;
    
    return ;

}


if( fsm_state == 2 ) {

    

if( fsm_step == 1 ) {

//	fsm_Log( F( "mmm" ) , "zzzz" ) ;

    fsm_stateSet( 3 ) ;

    return ;

}


    ////

    fsm_stepSet( 1 ) ;
    
    return ;

}


if( fsm_state == 3 ) {

    
if( fsm_step == 1 ) {

    fsm_stepNext( ) ;

    return ;

}


if( fsm_step == 2 ) {

//  fsm_modeSet( 2 ) ;
    return ;

}




    ////

    fsm_stepSet( 1 ) ;
    
    return ;

}


            ////
            fsm_stateSet( 1 ) ;

            return ;

        }
    //////////////////////////////////////

    
    //////////////////////////////////////
        if( fsm_mode == 3 ) {

            //fsm_Log( F( "fsm_ PRE MODE?" ) ) ;

            wizard_fsmModePre( ) ;

            
if( fsm_state == 1 ) {

    

if( fsm_step == 1 ) {


//  wizard_incoming_flag_listen_set( false ) ;

  motor1_stop( ) ;
  motor2_stop( ) ;

  encoder1_trigger_disable( ) ;
  encoder2_trigger_disable( ) ;
  
  imu_trigger_disable( ) ;
  
  distance_trigger_disable( ) ;

  motor1_trigger_disable( ) ;
  motor2_trigger_disable( ) ;

  fsm_stateSet( 2 ) ;

  return ;

}




    ////

    fsm_stepSet( 1 ) ;
    
    return ;

}


if( fsm_state == 2 ) {

    

if( fsm_step == 1 ) {

//	fsm_Log( F( "mmm" ) , "zzzz" ) ;

  wizard_motion_scan_init( ) ;

  fsm_stepNext( ) ;

  return ;

}


if( fsm_step == 2 ) {


  if( wizard_motion_scan_update( ) ) {

    fsm_stateSet( 3 ) ;

  }

  return ;

}




    ////

    fsm_stepSet( 1 ) ;
    
    return ;

}


if( fsm_state == 3 ) {

    

if( fsm_step == 1 ) {

//	fsm_Log( F( "mmm" ) , "zzzz" ) ;

  wizard_motion_turntominimum_init( ) ;
  fsm_stepNext( ) ;

  return ;

}


if( fsm_step == 2 ) {


  if( wizard_motion_turntominimum_update( ) ) {

    fsm_stateSet( 4 ) ;

  }

  return ;

}




    ////

    fsm_stepSet( 1 ) ;
    
    return ;

}


if( fsm_state == 4 ) {

    
if( fsm_step == 1 ) {


  wizard_incoming_flag_listen_set( true ) ;
  websocketserver_ws.printfAll( "%d,S,%d" , clock_getTimeMillis( ) , 0 ) ;
  fsm_modeSet( 2 ) ;
  return ;

}






    ////

    fsm_stepSet( 1 ) ;
    
    return ;

}


            ////
            fsm_stateSet( 1 ) ;

            return ;

        }
    //////////////////////////////////////

    
////////////////////////////////

//    fsm_Log( "BOOTING" ) ;

    //fsm_Log( "fsm_ POST MODE?" ) ;

    fsm_modeSet( 1 ) ;

}

void fsm_modeSet( byte mode ) {

    if( fsm_mode == mode ) {

        return ;

    }
    
    fsm_mode = mode ;
    fsm_state = 1 ;
    fsm_step = 1 ;

    fsm_changed = true ;

    wizard_fsmModeChange( ) ;

}

void fsm_stateSet( byte state ) {
    
    if( fsm_state == state ) {

        return ;

    }

    fsm_state = state ;
    fsm_step = 1 ;

    fsm_changed = true ;

    wizard_fsmStateChange( ) ;

}

void fsm_stepSet( byte step ) {
    
    if( fsm_step == step ) {

        return ;

    }

    fsm_step = step ;

    // to many messages to include step changes
    //fsm_changed = true ;

    wizard_fsmStepChange( ) ;

}

void fsm_stepNext( ) {

    fsm_stepSet( fsm_step + 1 ) ;

}

void fsm_stepPrevious( ) {

    fsm_stepSet( fsm_step - 1 ) ;

}

void fsm_stepFirst( ) {

    fsm_stepSet( 1 ) ;

}









#define wizard_modulename F( "wizard_" )



void wizard_Log( const __FlashStringHelper * k , unsigned long i ) {

    log_initClientModule( wizard_modulename , k ) ;
    log_print( i ) ;

}




/*
void wizard_serialPrint( const char * i , bool newline ) {

    serial_print( i , newline ) ;

}


void wizard_serialPrint( byte i , bool newline ) {

    serial_print( i , newline ) ;

}

void wizard_serialPrint( int i , bool newline ) {

    serial_print( i , newline ) ;

}

void wizard_serialPrint( unsigned int i , bool newline ) {

    serial_print( i , newline ) ;

}

void wizard_serialPrint( long i , bool newline ) {

    serial_print( i , newline ) ;

}

void wizard_serialPrint( unsigned long i , bool newline ) {

    serial_print( i , newline ) ;

}

void wizard_serialPrint( const __FlashStringHelper * i , bool newline ) {

    serial_print( i , newline ) ;

}



*/

bool wizard_incoming_flag_listen = false ;


void wizard_incoming_flag_listen_set( bool f ) {

  wizard_incoming_flag_listen = f ;

}

bool wizard_incomingParse( char * buffer ) {

  if( ! wizard_incoming_flag_listen ) {

    Serial.println( "!wizard_incoming_flag_listen" ) ;
    return( false ) ;

  }

    char *arr[ 16 ] ;
    int total_parameters = 0 ;

    arr[ total_parameters ] = strtok( buffer , "," ) ;

    while( arr[ total_parameters ] != NULL ) {

      arr[ ++total_parameters ] = strtok( NULL , "," ) ;

      if( total_parameters == 16 ) break ;

      /*
      if( arr[ total_parameters - 1 ] != NULL ){
        Serial.print( total_parameters - 1 ) ;
        Serial.print( "[" ) ;
        Serial.print( arr[ total_parameters - 1 ] ) ;
        Serial.println( "]" ) ;
      }
      */

    }

    if( total_parameters == 0 ) return( false ) ;

    if( ( strcmp( "_monitor_on" , arr[ 0 ] ) == 0 ) && ( total_parameters == 1 ) ) {

      websocketserver_monitor = true ;
      Serial.println( "monitor on" ) ;
    
      return( true ) ;
    
    }

    if( ( strcmp( "_monitor_off" , arr[ 0 ] ) == 0 ) && ( total_parameters == 1 ) ) {
      websocketserver_monitor=false;
      Serial.println("monitor off");
      return(true);
    }

    if( ( strcmp( "S" , arr[ 0 ] ) == 0 ) && ( total_parameters == 1 ) ) {

      wizard_incoming_flag_listen_set( false ) ;
      fsm_modeSet( 3 ) ;
      Serial.println("scan!");
      return(true);

    }

    if( ( strcmp( "O" , arr[ 0 ] ) == 0 ) && ( total_parameters == 1 ) ) {

      Serial.println( "origin!" ) ;

      motor1_stop( ) ;
      motor2_stop( ) ;
      encoder1_set( 0 ) ;
      encoder2_set( 0 ) ;
      imu_zinit( ) ;

      return( true ) ;

    }

    if( ( strcmp( ">" , arr[ 0 ] ) == 0 ) && ( total_parameters == 10 ) ) {

      // 

      if( strcmp( "*" , arr[ 1 ] ) != 0 ) {

        motor2_set_power( atoi( arr[ 1 ] ) ) ;
        motor2_start( ) ;

      }

      if( strcmp( "*" , arr[ 2 ] ) != 0 ) {

        motor1_set_power( atoi( arr[ 2 ] ) ) ;
        motor1_start( ) ;

      }

      if( strcmp( "*" , arr[ 3 ] ) != 0 ) {

        if(motor2_get_power()>0){
          encoder2_set_trigger( atoi(arr[3])) ;
        }else{
          encoder2_set_trigger( -1*atoi(arr[3])) ;
        }

      }

      if( strcmp( "*" , arr[ 4 ] ) != 0 ) {

        if(motor1_get_power()>0){
          encoder1_set_trigger( atoi(arr[4])) ;
        }else{
          encoder1_set_trigger( -1*atoi(arr[4])) ;
        }

      }


      if( strcmp( "*" , arr[ 5 ] ) != 0 ) {

          imu_set_trigger( atoi(arr[5])) ;

      }

      if( strcmp( "*" , arr[ 6 ] ) != 0 ) {

          distance_set_trigger_min( atoi(arr[6])) ;

      }

      if( strcmp( "*" , arr[ 7 ] ) != 0 ) {

          distance_set_trigger_max( atoi(arr[7])) ;

      }

      if( strcmp( "*" , arr[ 8 ] ) != 0 ) {

          motor2_timer_set( atoi(arr[8])) ;

      }
      if( strcmp( "*" , arr[ 9 ] ) != 0 ) {

          motor1_timer_set( atoi(arr[9])) ;

      }

      //Serial.println( "OK" ) ;
      return( true ) ;

    }

    return( false ) ;


}

void wizard_fsmModePre( ) {


}


void wizard_fsmModeChange( ) {

    //wizard_Log("wizard_fsmModeChange"));

}

void wizard_fsmStateChange( ) {
    //wizard_Log(F("wizard_fsmStateChange"));

}

void wizard_fsmStepChange( ) {
    //wizard_Log(F("wizard_fsmStepChange"));

}





void wizard_util_disable_all_triggers( ) {

/*
  imu_trigger_direction = 0 ;
  encoder1_trigger_direction = 0 ;
  encoder2_trigger_direction = 0 ;
  distance_trigger_direction = 0 ;
*/
  
}

float wizard_motion_z_start = 0 ;
float wizard_motion_z_current = 0 ;

int wizard_map_distance[ 360 ] ;
int wizard_map_distance_pointer = 0 ;
int wizard_distance_current = 0 ;

void wizard_motion_scan_init( ) {

  wizard_map_distance_pointer = 0 ;

  for( int i = 0 ; i < 360 ; i++ ) {

    wizard_map_distance[ i ] = -1 ;

  }

  wizard_motion_z_start = imu_getz( ) ;

  motor1_set_power( -20 ) ;
  motor1_start( ) ;
  motor2_set_power( 20 ) ;
  motor2_start( ) ;

  //Serial.println( wizard_motion_z_start ) ;

}


bool wizard_motion_scan_update( ) {

  wizard_motion_z_current = imu_getz( ) - wizard_motion_z_start ;

  if( wizard_motion_z_current >= 360 ) {

    motor1_stop( ) ;
    motor2_stop( ) ;
  //for( int i = 0 ; i<360;i++){
  //  Serial.println(wizard_map_distance[i]);
  //}
    wizard_motion_scan_find_min( ) ;

    return( true ) ;
  
  }

  wizard_distance_current = distance_get_range( ) ;

  //Serial.println(wizard_distance_current);

  //if( wizard_distance_current > 1000 ) wizard_distance_current = 0 ;

  wizard_map_distance_pointer = ( int ) wizard_motion_z_current ;
  wizard_map_distance[ wizard_map_distance_pointer ] = wizard_distance_current ;

  return( false ) ;

}

void wizard_motion_scan_find_min( ) {

  int m = 9999 ;
  int p = 0 ;

  for( int i = 0 ; i < 360 ; i++ ) {

    if( wizard_map_distance[ i ] == -1 ) continue ;

    if( wizard_map_distance[ i ] < m ) {
      //m=wizard_map_distance[i];
      m = wizard_map_distance[ i ] ;
      p = i ;

    }

  }

  wizard_map_distance_pointer = p ;

  //Serial.println( wizard_map_distance_pointer ) ;

}

void wizard_motion_turntominimum_init( ) {

  motor1_set_power( -20 ) ;
  motor1_start( ) ;
  motor2_set_power( 20 ) ;
  motor2_start( ) ;

  wizard_motion_z_start = imu_getz( ) ;

}

bool wizard_motion_turntominimum_update( ) {

  if( imu_getz( ) < ( wizard_motion_z_start + wizard_map_distance_pointer ) ) {

    return( false ) ;
  
  }

  motor1_stop( ) ;
  motor2_stop( ) ;

  return( true ) ;

}




#define grandmaster_modulename F( "grandmaster_" )



void grandmaster_Log( const __FlashStringHelper * k , unsigned long i ) {

    log_initClientModule( grandmaster_modulename , k ) ;
    log_print( i ) ;

}


bool grandmaster_Trigger( ) {

    static unsigned long triggerCurrentTime = micros( ) ;

    if( ( clock_getTimeMicros( ) - triggerCurrentTime ) < 100000L ) {

        return( false ) ;

    } else { 

        triggerCurrentTime = clock_getTimeMicros( ) ;

        return( true ) ;

    }

}





void grandmaster_Setups( ) {

    grandmaster_setup( ) ;

}




void grandmaster_Loops( ) {

    if( ! grandmaster_Trigger( ) ) return ;

    grandmaster_loop( ) ;

}




void grandmaster_setup( ) {

    //randomSeed( analogRead( 3 ) ) ;

}

void grandmaster_loop( ) {

    fsm_enabled = true ;


    if( WiFi.status( ) != WL_CONNECTED ) {

      led_set_sequence( 1 ) ;
      return ;

    }

    if( websocketserver_get_connected( ) ) { 

      led_set_sequence( 3 ) ;
      return ;

    }


    if( WiFi.status( ) == WL_CONNECTED ) {

      led_set_sequence( 2 ) ;
      return;

    }

    led_set_sequence( 1 ) ;

}




void setup( ) {

serial_Setups( ) ;
log_Setups( ) ;
clock_Setups( ) ;
led_Setups( ) ;
audio_Setups( ) ;
websocketserver_Setups( ) ;
encoder1_Setups( ) ;
encoder2_Setups( ) ;
motor1_Setups( ) ;
motor2_Setups( ) ;
imu_Setups( ) ;
distance_Setups( ) ;
fsm_Setups( ) ;
grandmaster_Setups( ) ;

}



void loop( ) {

serial_Loops( ) ;
log_Loops( ) ;
clock_Loops( ) ;
led_Loops( ) ;
audio_Loops( ) ;
websocketserver_Loops( ) ;
encoder1_Loops( ) ;
encoder2_Loops( ) ;
motor1_Loops( ) ;
motor2_Loops( ) ;
imu_Loops( ) ;
distance_Loops( ) ;
fsm_Loops( ) ;
grandmaster_Loops( ) ;

}

